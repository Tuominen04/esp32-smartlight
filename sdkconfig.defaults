## sdkconfig.defaults
```kconfig
#
# Enable Bluetooth
#
CONFIG_BT_ENABLED=y
CONFIG_BT_BLE_50_FEATURES_SUPPORTED=n
CONFIG_BT_BLE_42_FEATURES_SUPPORTED=y
CONFIG_BT_LE_50_FEATURE_SUPPORT=y

#
# Add this for ESP32-C6
#
CONFIG_BT_CTRL_MODE_EFF=1

#
# JSON parsing
#
CONFIG_CJSON_ENABLE=y

#
# Memory allocation for BLE
#
CONFIG_BTDM_RESERVE_DRAM=0x10000

#
# Partition Table
#
CONFIG_PARTITION_TABLE_TWO_OTA_LARGE=y

#
# Serial flasher config
#
CONFIG_ESPTOOLPY_FLASHSIZE_4MB=y
CONFIG_ESPTOOLPY_FLASHSIZE="4MB"
```
